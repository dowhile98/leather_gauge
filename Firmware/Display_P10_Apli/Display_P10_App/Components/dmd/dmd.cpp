/*
 * dmd.c
 *
 *  Created on: Aug 19, 2024
 *      Author: eplim
 */


/*Includes ------------------------------------------------------------------*/
#include "dmd.h"
#include <stdlib.h>
#include <string.h>
#include "Bitmap.h"
#include <cstddef>

/*Function definition ------------------------------------------------------*/

DMDESP::DMDESP(int widthPanels, int heightPanels)
    : Bitmap(widthPanels * DMDESP_NUM_COLUMNS, heightPanels * DMDESP_NUM_ROWS), useDoubleBuffer(false), phase(0), fb0(0), fb1(0), displayfb(0), lastRefresh(HAL_GetTick())
{
    // Both rendering and display are to fb0 initially.
    connectScheme = CONNECT_NORMAL;

	fb0 = displayfb = frame_buffer;

    HAL_GPIO_WritePin(A_GPIO_Port, A_Pin, GPIO_PIN_RESET);	// Set to LOW
    HAL_GPIO_WritePin(B_GPIO_Port, B_Pin, GPIO_PIN_RESET);	// Set to LOW

    //create update flag
    tickFlag = xSemaphoreCreateBinary();
    configASSERT(tickFlag != NULL);
    //mutex to access objets
    mutex = xSemaphoreCreateMutex();
    configASSERT(mutex != NULL);

    return;
}

void DMDESP::clearBuffer(void){
	memset(displayfb, 0, scr_stride * scr_height);
}
DMDESP::~DMDESP()
{
    if (fb0)
        dmd_free(fb0);
    if (fb1)
        dmd_free(fb1);
    frame_buffer = 0; // Don't free the buffer again in the base class.
}


void DMDESP:: setConnectScheme(uint8_t sch){
	this->connectScheme = sch;
}
bool DMDESP::mutexTake(BaseType_t wait){
	bool ret = false;
	if(xSemaphoreTake(mutex, wait) == pdPASS){
		ret = true;
	}
	return ret;
}
void DMDESP::mutexRelease(void){
	xSemaphoreGive(mutex);
}
void DMDESP::setDoubleBuffer(bool state)
{
    if (state != useDoubleBuffer)
    {
        useDoubleBuffer = state;
        if (state)
        {
            // Allocate a new back buffer.
            unsigned int size = scr_stride * scr_height;
            fb1 = (uint8_t *)dmd_malloc(size);

            // Clear the new back buffer and then switch to it, leaving
            // the current contents of fb0 on the screen.
            if (fb1)
            {
                memset(fb1, 0xFF, size);
                taskENTER_CRITICAL();
                frame_buffer = fb1;
                displayfb = fb0;
                taskEXIT_CRITICAL();
            }
            else
            {
                // Failed to allocate the memory, so revert to single-buffered.
                useDoubleBuffer = false;
            }
        }
        else if (fb1)
        {
            // Disabling double-buffering, so forcibly switch to fb0.
            taskENTER_CRITICAL(); // IRQ Disable
            frame_buffer = fb0;
            displayfb = fb0;
            taskEXIT_CRITICAL(); // IRQ Enable

            // Free the unnecessary buffer.
            dmd_free(fb1);
            fb1 = 0;
        }
    }
}

void DMDESP::swapBuffers()
{
    if (useDoubleBuffer)
    {
        // Turn off interrupts while swapping buffers so that we don't
        // accidentally try to refresh() in the middle of this code.
        taskENTER_CRITICAL(); // IRQ Disable
        if (frame_buffer == fb0)
        {
            frame_buffer = fb1;
            displayfb = fb0;
        }
        else
        {
            frame_buffer = fb0;
            displayfb = fb1;
        }
        taskEXIT_CRITICAL(); // IRQ Enable
    }
}

void DMDESP::swapBuffersAndCopy()
{
    swapBuffers();
    if (useDoubleBuffer)
        memcpy((void *)frame_buffer, (void *)displayfb, scr_stride * scr_height);
}


void dispinit(void)
{

}

void DMDESP::updateFlag(void){
	portBASE_TYPE taskWoken = pdFALSE;
	if(__get_IPSR() != 0){
		if (xSemaphoreGiveFromISR(tickFlag, &taskWoken) == pdTRUE) {
			portEND_SWITCHING_ISR(taskWoken);
		}
	}else{
		xSemaphoreGive(tickFlag);
	}
}
void DMDESP::loop()
{

    if (xSemaphoreTake(tickFlag, portMAX_DELAY) == pdPASS)
    {
    	mutexTake();
    	taskENTER_CRITICAL();
        refresh();
        taskEXIT_CRITICAL();
        mutexRelease();

    }
}

// Flip the bits in a byte.  Table generated by genflip.c
static const uint8_t flipBits[256]  = {
    0x00, 0x80, 0x40, 0xC0, 0x20, 0xA0, 0x60, 0xE0, 0x10, 0x90, 0x50, 0xD0,
    0x30, 0xB0, 0x70, 0xF0, 0x08, 0x88, 0x48, 0xC8, 0x28, 0xA8, 0x68, 0xE8,
    0x18, 0x98, 0x58, 0xD8, 0x38, 0xB8, 0x78, 0xF8, 0x04, 0x84, 0x44, 0xC4,
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    0x3F, 0xBF, 0x7F, 0xFF};

void DMDESP::refresh()
{
	 bool flipRow = false;
    // Transfer the data for the next group of interleaved rows.
    int stride4 = scr_stride * 4;

    volatile uint8_t *data0;
    volatile uint8_t *data1;
    volatile uint8_t *data2;
    volatile uint8_t *data3;

    if(connectScheme == CONNECT_NORMAL){
    	 flipRow = ((scr_height & 0x10) == 0);
    }

    for (uint8_t y = 0; y < scr_height; y += DMDESP_NUM_ROWS)
    {
        if (!flipRow)
        {
            // The panels in this row are the right way up.
            data0 = displayfb + scr_stride * (y + phase);
            data1 = data0 + stride4;
            data2 = data1 + stride4;
            data3 = data2 + stride4;
            for (int x = scr_stride; x > 0; --x)
            {
                HAL_SPI_Transmit(&hspi1, (uint8_t *)data3++, 1, 100);
                HAL_SPI_Transmit(&hspi1, (uint8_t *)data2++, 1, 100);
                HAL_SPI_Transmit(&hspi1, (uint8_t *)data1++, 1, 100);
                HAL_SPI_Transmit(&hspi1, (uint8_t *)data0++, 1, 100);
            }
            if(connectScheme == CONNECT_NORMAL){
            	flipRow = true;
            }
        }
        else
        {
            data0 = displayfb + scr_stride * (y + DMDESP_NUM_ROWS - phase) - 1;
            data1 = data0 - stride4;
            data2 = data1 - stride4;
            data3 = data2 - stride4;
            for (int x = scr_stride; x > 0; --x)
            {
            	HAL_SPI_Transmit(&hspi1, (uint8_t *)&(flipBits[*data3--]), 1, 100);
            	HAL_SPI_Transmit(&hspi1, (uint8_t *)&(flipBits[*data2--]), 1, 100);
            	HAL_SPI_Transmit(&hspi1, (uint8_t *)&(flipBits[*data1--]), 1, 100);
            	HAL_SPI_Transmit(&hspi1, (uint8_t *)&(flipBits[*data0--]), 1, 100);
            }
            flipRow = false;
        }
    }

    HAL_GPIO_WritePin(LATCH_GPIO_Port, LATCH_Pin, GPIO_PIN_SET); 	// Set to HIGH

    HAL_GPIO_WritePin(LATCH_GPIO_Port, LATCH_Pin, GPIO_PIN_RESET);	// Set to LOW

    HAL_GPIO_WritePin(A_GPIO_Port, A_Pin, (phase & 1) ? GPIO_PIN_SET : GPIO_PIN_RESET);	// Set to LOW
	HAL_GPIO_WritePin(B_GPIO_Port, B_Pin, (phase & 1<<1) ? GPIO_PIN_SET : GPIO_PIN_RESET);	// Set to LOW

	//pwm for brightness

	__HAL_TIM_SET_COMPARE(&htim2, TIM_CHANNEL_2, brightness);


    phase = (phase + 1) & 0x03;
}

void DMDESP::start()
{
	HAL_TIM_PWM_Start(&htim2, TIM_CHANNEL_2);

    dispinit();
}

void DMDESP::setBrightness(uint8_t brightness)
{
    if (brightness > 100)
        brightness = 100;
    //set new pwm duty
    this->brightness = brightness * 10;
}
